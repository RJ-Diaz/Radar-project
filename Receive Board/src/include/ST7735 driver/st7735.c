#include "st7735.h"
#include <avr/io.h>
#include <util/delay.h>
#include <avr/pgmspace.h>
#include <stdlib.h>

#define CS_PORT    PORTB
#define DC_PORT    PORTB
#define RST_PORT   PORTB
#define CS_PIN     PB2
#define DC_PIN     PB1
#define RST_PIN    PB0

static const uint8_t font5x7[][5] PROGMEM = {
	{0x00,0x00,0x00,0x00,0x00}, // space
	{0x00,0x00,0x5F,0x00,0x00}, // !
	{0x00,0x07,0x00,0x07,0x00}, // "
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	{0x08,0x1C,0x2A,0x08,0x08}  // <-
};


static void spi_write(uint8_t data) {
	SPDR = data;
	while (!(SPSR & (1 << SPIF)));
}

static void write_command(uint8_t cmd) {
	DC_PORT &= ~(1 << DC_PIN);
	CS_PORT &= ~(1 << CS_PIN);
	spi_write(cmd);
	CS_PORT |= (1 << CS_PIN);
}

static void write_data(uint8_t data) {
	DC_PORT |= (1 << DC_PIN);
	CS_PORT &= ~(1 << CS_PIN);
	spi_write(data);
	CS_PORT |= (1 << CS_PIN);
}

void ST7735_Init(void) {
	// Set control pins as output
	DDRB |= (1 << CS_PIN) | (1 << DC_PIN) | (1 << RST_PIN);
	DDRB |= (1 << PB3) | (1 << PB5); // MOSI, SCK

	// SPI setup
	SPCR = (1 << SPE) | (1 << MSTR);
	SPSR |= (1 << SPI2X);

	// Reset sequence
	RST_PORT |= (1 << RST_PIN);
	_delay_ms(100);
	RST_PORT &= ~(1 << RST_PIN);
	_delay_ms(100);
	RST_PORT |= (1 << RST_PIN);
	_delay_ms(100);

	// Software reset
	write_command(0x01);
	_delay_ms(150);

	// Sleep out
	write_command(0x11);
	_delay_ms(500);

	// Frame rate control
	write_command(0xB1); write_data(0x01); write_data(0x2C); write_data(0x2D);
	write_command(0xB2); write_data(0x01); write_data(0x2C); write_data(0x2D);
	write_command(0xB3); write_data(0x01); write_data(0x2C); write_data(0x2D);
	write_data(0x01); write_data(0x2C); write_data(0x2D);

	// Power control
	write_command(0xB4); write_data(0x07);
	write_command(0xC0); write_data(0xA2); write_data(0x02); write_data(0x84);
	write_command(0xC1); write_data(0xC5);
	write_command(0xC2); write_data(0x0A); write_data(0x00);
	write_command(0xC3); write_data(0x8A); write_data(0x2A);
	write_command(0xC4); write_data(0x8A); write_data(0xEE);

	// VCOM
	write_command(0xC5); write_data(0x0E);

	// Memory access control (orientation + RGB order)
	write_command(0x36); write_data(0xC8);  // MX, MY, RGB

	// Color mode: 16-bit
	write_command(0x3A); write_data(0x05);

	// Gamma correction
	write_command(0xE0);
	write_data(0x02); write_data(0x1C); write_data(0x07); write_data(0x12);
	write_data(0x37); write_data(0x32); write_data(0x29); write_data(0x2D);
	write_data(0x29); write_data(0x25); write_data(0x2B); write_data(0x39);
	write_data(0x00); write_data(0x01); write_data(0x03); write_data(0x10);

	write_command(0xE1);
	write_data(0x03); write_data(0x1D); write_data(0x07); write_data(0x06);
	write_data(0x2E); write_data(0x2C); write_data(0x29); write_data(0x2D);
	write_data(0x2E); write_data(0x2E); write_data(0x37); write_data(0x3F);
	write_data(0x00); write_data(0x00); write_data(0x02); write_data(0x10);

	// Display on
	write_command(0x29);
	_delay_ms(100);
}

void ST7735_DrawPixel(uint8_t x, uint8_t y, uint16_t color) {
	write_command(0x2A); // Column addr set
	write_data(0x00);
	write_data(x);
	write_data(0x00);
	write_data(x);

	write_command(0x2B); // Row addr set
	write_data(0x00);
	write_data(y);
	write_data(0x00);
	write_data(y);

	write_command(0x2C); // Write to RAM
	write_data(color >> 8);
	write_data(color & 0xFF);
}

void ST7735_FillScreen(uint16_t color) {
	for (uint8_t y = 0; y < 160; y++) {
		for (uint8_t x = 0; x < 128; x++) {
			ST7735_DrawPixel(x, y, color);
		}
	}
}
void ST7735_DrawChar(uint8_t x, uint8_t y, char c, uint16_t color) {
	if (c < 32 || c > 126) return; // Only printable ASCII
	for (uint8_t i = 0; i < 5; i++) {
		uint8_t line = pgm_read_byte(&font5x7[c - 32][i]);
		for (uint8_t j = 0; j < 8; j++) {
			if (line & (1 << j)) {
				ST7735_DrawPixel(x + i, y + j, color);
			}
		}
	}
}
void ST7735_DrawString(uint8_t x, uint8_t y, const char *str, uint16_t color) {
	while (*str) {
		ST7735_DrawChar(x, y, *str, color);
		x += 6; // 5 pixels + 1 spacing
		str++;
	}
}
#include <math.h>

void ST7735_DrawLine(uint8_t x0, uint8_t y0, uint8_t x1, uint8_t y1, uint16_t color) {
	int dx = abs(x1 - x0), sx = x0 < x1 ? 1 : -1;
	int dy = -abs(y1 - y0), sy = y0 < y1 ? 1 : -1;
	int err = dx + dy, e2;

	while (1) {
		ST7735_DrawPixel(x0, y0, color);
		if (x0 == x1 && y0 == y1) break;
		e2 = 2 * err;
		if (e2 >= dy) { err += dy; x0 += sx; }
		if (e2 <= dx) { err += dx; y0 += sy; }
	}
}
